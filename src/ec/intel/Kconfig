## src/ec/intel/Kconfig
```kconfig
## SPDX-License-Identifier: GPL-2.0-only

config EC_INTEL_ADLP
        bool
	select EC_ACPI
        help
          INTEL ADLP Embedded Controller interface
```

## src/mainboard/intel/adlrvp/Kconfig
```kconfig
config BOARD_INTEL_ADLRVP_COMMON
	def_bool n
	select BOARD_ROMSIZE_KB_32768
	select DRIVERS_I2C_GENERIC
	select DRIVERS_I2C_HID
	select DRIVERS_I2C_MAX98373
	select DRIVERS_INTEL_DPTF
	select DRIVERS_SPI_ACPI
	select DRIVERS_USB_ACPI
	select HAVE_ACPI_RESUME
	select HAVE_ACPI_TABLES
	select HAVE_SPD_IN_CBFS
	select SOC_INTEL_COMMON_BLOCK_IPU
	select SOC_INTEL_ENABLE_USB4_PCIE_RESOURCES
#	select HAVE_SMI_HANDLER

config BOARD_INTEL_ADLRVP_P
	select BOARD_INTEL_ADLRVP_COMMON
	select DRIVERS_UART_8250IO
	select MAINBOARD_USES_IFD_EC_REGION
	select SOC_INTEL_ALDERLAKE_PCH_P
	select MAINBOARD_USES_IFD_GBE_REGION
	select SOC_INTEL_COMMON_BLOCK_HDA_VERB  # Audio
	select DRIVERS_WIFI_GENERIC 		# WLAN
	select DRIVERS_INTEL_ISH                # ISH
	select SOC_INTEL_STORE_ISH_FW_VERSION   # ISH
	select MAINBOARD_HAS_TPM2
	select MEMORY_MAPPED_TPM

if BOARD_INTEL_ADLRVP_COMMON

#config SOC_INTEL_CSE_LITE_SKU
#	bool "Use CSE Lite firmware"
#	default y if ADL_CHROME_EC
#	help
#	  Enable if CSE Lite firmware is used in your build. It is commonly
#	  used in Chrome boards (chromebooks, chromeboxes, ...).
#	  But since ADL RVP build can be used with or without CSE Lite firmware
#	  it is a configurable option. Alderlake RVP boards usually don't use
#	  an CSE Lite firmware, but are still very likely to use it in case
#	  ChromeEC is used.

config MAINBOARD_DIR
	default "intel/adlrvp"

config VARIANT_DIR
	default "adlrvp_p" if BOARD_INTEL_ADLRVP_P

config MAINBOARD_PART_NUMBER
	default "Alder Lake Client"

config MAINBOARD_VENDOR
	string
	default "Intel Corporation"

config MAINBOARD_FAMILY
	string
	default "Intel_adlrvp"

config DEVICETREE
	default "devicetree.cb"

config OVERRIDE_DEVICETREE
	default "variants/\$(CONFIG_VARIANT_DIR)/overridetree.cb"

config DIMM_SPD_SIZE
	default 512

choice
	prompt "ON BOARD EC"
	default ADL_INTEL_EC if BOARD_INTEL_ADLRVP_P 
	help
	  This option allows you to select the on board EC to use.
	  Select whether the board has Intel EC or Chrome EC

#config ADL_CHROME_EC
#	bool "Chrome EC"
#	select EC_GOOGLE_CHROMEEC
#	select EC_GOOGLE_CHROMEEC_ESPI
#	select EC_GOOGLE_CHROMEEC_BOARDID
#	select EC_ACPI
#	select EC_GOOGLE_CHROMEEC_LPC

config ADL_INTEL_EC
        bool "Intel EC"
#	select EC_INTEL_ADLP
        select EC_ACPI
endchoice

config UART_FOR_CONSOLE
	int
	default 0

config GEN3_EXTERNAL_CLOCK_BUFFER
        bool
        depends on SOC_INTEL_ALDERLAKE_PCH_P
        default n
        help
          Support external Gen-3 clock chip for ADL-P.
          CONFIG_CLKSRC_FOR_EXTERNAL_BUFFER provides feed clock to discrete buffer
          for further distribution to platform. SRCCLKREQB[7:9] maps to internal
          SRCCLKREQB[6]. If any of them asserted, SRC buffer
          CONFIG_CLKSRC_FOR_EXTERNAL_BUFFER gets enabled.

config CLKSRC_FOR_EXTERNAL_BUFFER
        depends on GEN3_EXTERNAL_CLOCK_BUFFER
        int
        default 6  # CLKSRC 6

endif
```
